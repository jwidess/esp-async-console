## Kconfig
```kconfig
menu "Async Console Configuration"

    config ASYNC_CONSOLE_MAX_CMDLINE_ARGS
        int "Maximum command line arguments"
        default 8
        help
            Maximum number of elements parsed by the console.
            Note: ESP-IDF reserves 1 slot for the command name and 1 slot for a NULL terminator.
            Therefore, a value of 16 allows a command name + 14 arguments.

    config ASYNC_CONSOLE_MAX_CMDLINE_LENGTH
        int "Maximum command line length"
        default 256
        help
            Maximum length of a command line in bytes.

endmenu
```

## examples/basic_repl/sdkconfig.defaults
```kconfig
CONFIG_ESP_CONSOLE_UART=y
CONFIG_ESP_CONSOLE_UART_NUM=0

# Must define `CONFIG_ESP_CONSOLE_UART_CUSTOM=y` to use custom baudrate
CONFIG_ESP_CONSOLE_UART_CUSTOM=y
CONFIG_ESP_CONSOLE_UART_BAUDRATE=115200

# Disabled BT to reduce binary size for test
CONFIG_BT_ENABLED=n

# Log colors and verbosity
CONFIG_LOG_COLORS=y
CONFIG_LOG_DEFAULT_LEVEL_INFO=y
CONFIG_LOG_MAXIMUM_LEVEL=5
CONFIG_LOG_MAXIMUM_LEVEL_VERBOSE=y
CONFIG_LOG_MAXIMUM_EQUALS_DEFAULT=n
```
